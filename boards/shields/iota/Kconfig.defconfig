## boards/shields/iota/Kconfig.defconfig
```kconfig
if SHIELD_IOTA_LEFT

config ZMK_KEYBOARD_NAME
    default "Iota"

config ZMK_SPLIT_ROLE_CENTRAL
    default y

endif

if SHIELD_IOTA_RIGHT

config ZMK_KEYBOARD_NAME
    default "Iota R Test"

endif

if SHIELD_IOTA_LEFT || SHIELD_IOTA_RIGHT

config ZMK_SPLIT
    default y

endif
```

## boards/shields/iota/Kconfig.shield
```kconfig
config SHIELD_IOTA_LEFT
    def_bool $(shields_list_contains,iota_left)

config SHIELD_IOTA_RIGHT
    def_bool $(shields_list_contains,iota_right)
```
